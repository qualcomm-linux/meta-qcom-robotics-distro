## conf/distro/include/qcom-robotics-sdk.inc
```bitbake
# To include host packages in SDK
#TOOLCHAIN_HOST_TASK:append = " nativesdk-protobuf-compiler "

# To include target packages in SDK
#TOOLCHAIN_TARGET_TASK:append = " resize-partitions"

#TOOLCHAIN_TARGET_TASK:append = " opencv"


# To provide tools for ROS node compile in SDK
TOOLCHAIN_HOST_TASK:append = "${@bb.utils.contains('DISTRO_FEATURES', 'ros2-humble', ' \
    nativesdk-ament-package \
    nativesdk-python3-colcon-common-extensions \
    nativesdk-python3-numpy \
    nativesdk-rosidl-adapter \
    nativesdk-rosidl-cli \
    nativesdk-rosidl-cmake \
    nativesdk-rosidl-generator-c \
    nativesdk-rosidl-generator-cpp \
    nativesdk-rosidl-parser \
    nativesdk-rosidl-typesupport-c \
    nativesdk-rosidl-typesupport-cpp \
    nativesdk-rosidl-typesupport-fastrtps-c \
    nativesdk-rosidl-typesupport-fastrtps-cpp \
    nativesdk-rosidl-typesupport-introspection-c \
    nativesdk-rosidl-typesupport-introspection-cpp \
', '', d)}"

TOOLCHAIN_TARGET_TASK:remove = "qirp-sdk"
TOOLCHAIN_TARGET_TASK:remove = "qirf-sdk"
```

## conf/distro/qcom-robotics-ros.conf
```bitbake
require conf/distro/include/qcom-base.inc

DISTRO_NAME = "QCOM Robotics Reference Distro with Ros"

DISTRO_FEATURES:append = " wayland"
DISTRO_FEATURES:append = " ros"
DISTRO_FEATURES:remove = " selinux"

DISTROOVERRIDES = "qcom-robotics-ros"
```

## conf/distro/qcom-robotics-ros2-humble.conf
```bitbake
require conf/distro/include/qcom-robotics-sdk.inc
require conf/distro/qcom-wayland.conf

DISTRO_NAME = "QCOM Robotics Reference Distro with ROS"

DISTRO_FEATURES:append = " ros2-humble"

DISTROOVERRIDES = "qcom-robotics-ros"
```

## conf/distro/qcom-robotics-wayland.conf
```bitbake
require conf/distro/include/qcom-robotics-sdk.inc
require conf/distro/include/qcom-base.inc

DISTRO_NAME = "QCOM Reference Distro with Wayland"

DISTRO_FEATURES:append = " wayland"

DISTROOVERRIDES = "qcom-robotics-wayland"
```

## conf/layer.conf
```bitbake
# We have a conf and classes directory, add to BBPATH
BBPATH .= ":${LAYERDIR}"

# We have recipes-* directories, add to BBFILES
BBFILES += "${LAYERDIR}/recipes-*/*/*.bb \
            ${LAYERDIR}/recipes-*/*/*.bbappend \
            ${LAYERDIR}/recipes-*/*.bbappend \
            ${LAYERDIR}/recipes-*/*.bb \
"

BBFILE_COLLECTIONS += "qcom-robotics-distro"
BBFILE_PATTERN_qcom-robotics-distro = "^${LAYERDIR}/"
BBFILE_PRIORITY_qcom-robotics-distro = "10"
LAYERSERIES_COMPAT_qcom-robotics-distro = "kirkstone scarthgap"
```
